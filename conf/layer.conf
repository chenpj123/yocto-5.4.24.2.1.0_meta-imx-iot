## conf/layer.conf
```bitbake
# We have a conf and classes directory, add to BBPATH
BBPATH .= ":${LAYERDIR}"

# We have recipes-* directories, add to BBFILES
BBFILES += "${LAYERDIR}/recipes-*/*/*.bb \
            ${LAYERDIR}/recipes-*/*/*.bbappend"

BBFILE_COLLECTIONS += "imx-iot-layer"
BBFILE_PATTERN_imx-iot-layer = "^${LAYERDIR}/"
BBFILE_PRIORITY_imx-iot-layer = "9"

LAYERDEPENDS_imx-iot-layer = "core"
LAYERSERIES_COMPAT_imx-iot-layer = "warrior zeus"
```

## conf/machine/imx8mpiot.conf
```bitbake
#@TYPE: Machine
#@NAME: NXP i.MX8MP IOT
#@SOC: i.MX8MP
#@DESCRIPTION: Machine configuration for NXP i.MX8MP IOT
#@MAINTAINER: leemeiyung <leemeiyung@sina.com>

MACHINEOVERRIDES =. "mx8:mx8m:mx8mp:"

require conf/machine/include/imx-base.inc
require conf/machine/include/tune-cortexa53.inc

MACHINE_FEATURES += " pci wifi bluetooth optee nxp8997 jailhouse"

KERNEL_DEVICETREE = " \
                     freescale/imx8mp-iot.dtb \
"
# Add DTB of i.MX 8MP DDR4 EVK
KERNEL_DEVICETREE += " \
                     freescale/imx8mp-iot.dtb \
"


WKS_FILE_DEPENDS_append = " imx-m7-demos"
IMAGE_BOOT_FILES += "imx8mp_m7_TCM_hello_world.bin \
                    imx8mp_m7_TCM_rpmsg_lite_pingpong_rtos_linux_remote.bin \
                    imx8mp_m7_TCM_rpmsg_lite_str_echo_rtos.bin \
                    imx8mp_m7_TCM_sai_low_power_audio.bin \
"

UBOOT_CONFIG ??= "sd"
UBOOT_CONFIG[sd] = "imx8mp_iot_defconfig,sdcard"
UBOOT_CONFIG[fspi] = "imx8mp_iot_defconfig"
UBOOT_CONFIG[ecc] = "imx8mp_iot_inline_ecc_defconfig"
UBOOT_CONFIG[mfgtool] = "imx8mp_iot_defconfig"
SPL_BINARY = "spl/u-boot-spl.bin"

# Set DDR FIRMWARE
DDR_FIRMWARE_NAME = "lpddr4_pmu_train_1d_dmem_201904.bin lpddr4_pmu_train_1d_imem_201904.bin lpddr4_pmu_train_2d_dmem_201904.bin lpddr4_pmu_train_2d_imem_201904.bin"

# Set u-boot DTB
UBOOT_DTB_NAME = "imx8mp-iot.dtb"

IMXBOOT_DTB_NAME = "imx8mp-iot.dtb"
# Set imx-mkimage boot target
IMXBOOT_TARGETS = "${@bb.utils.contains('UBOOT_CONFIG', 'fspi', 'flash_evk_flexspi', 'flash_evk',  d)}"

# Set Serial console
SERIAL_CONSOLES = "115200;ttymxc1"

IMAGE_BOOTLOADER = "imx-boot"

LOADADDR = ""
UBOOT_SUFFIX = "bin"
UBOOT_MAKE_TARGET = ""
IMX_BOOT_SEEK = "32"

OPTEE_BIN_EXT = "8mp"
```
